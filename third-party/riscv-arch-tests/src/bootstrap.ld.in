OUTPUT_ARCH( "riscv" )
ENTRY(_start)

#include "pma-defines.h"

SECTIONS
{
  . = PMA_UARCH_RAM_START_DEF;
  .text.init : { *(.text.init) }
  . = ALIGN(0x1000);
  .text : { *(.text) }
  . = ALIGN(0x1000);
  .data : { *(.data) }
  .bss : { *(.bss) }
  _end = .;
}
