OUTPUT_ARCH( "riscv" )
ENTRY(rvtest_entry_point)

#include "pma-defines.h"

SECTIONS
{
  . = PMA_UARCH_RAM_START_DEF;
  .text.init : { *(.text.init) }
  . = ALIGN(0x1000);
  .text : { *(.text) }
  . = ALIGN(0x1000);
  _end = .;
}
