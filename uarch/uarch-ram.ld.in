OUTPUT_ARCH( "riscv" )
ENTRY(_start)

#include "address-range-defines.h"

SECTIONS
{
  . = AR_UARCH_RAM_START_DEF;
  .text.init : { *(.text.init) }
  /* Hot path first, so one big-machine instruction touches few witness pages:
     the interpret loop, fetch and dispatch, address translation, the TLB slot
     check and the load/store slow paths. Order comes from tracing uarch PCs
     over a whole mcycle and counting cycles per code page. validate-layout
     checks these land in the first 64 KiB. */
  .text : {
    *(.text._ZN7cartesiL14interpret_loop*)
    *(.text._ZN7cartesi9interpret*)
    *(.text.interpret_next_mcycle_with_uarch*)
    *(.text._ZN7cartesiL25translate_virtual_address*)
    *(.text._ZN7cartesiL22shadow_tlb_verify_slot*)
    *(.text._ZN7cartesiL13assert_no_brk*)
    *(.text._ZN7cartesi19uarch_address_range10initialize*)
    *(.text._ZN7cartesiL24read_virtual_memory_slowI[lm]*)
    *(.text._ZN7cartesiL25write_virtual_memory_slowI[lm]*)
    *(.text._ZN7cartesiL24read_virtual_memory_slowI[ij]*)
    *(.text._ZN7cartesiL25write_virtual_memory_slowI[ij]*)
    *(.text .text.*)
  }
  .rodata : { *(.rodata) }
  .sdata : { *(.sdata) }
  .bss : { *(.bss) }
  .tdata : { *(.tdata) }

  _end = .;
}
