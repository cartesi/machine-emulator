OUTPUT_ARCH( "riscv" )
ENTRY(_start)

#include "pma-defines.h"

SECTIONS
{
  . = PMA_UARCH_ROM_START_DEF;
  .text.init : { *(.text.init) }
  .text : { *(.text) }
  .rodata : { *(.rodata) }  
  .sdata : { *(.sdata) }
  .bss : { *(.bss) }  
  .tdata : { *(.tdata) }  
  _end = .;
}
